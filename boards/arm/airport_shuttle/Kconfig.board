## boards/arm/airport_shuttle/Kconfig.board
```kconfig
# Paw board configuration

# Copyright (c) 2020 Taylor Glaeser
# SPDX-License-Identifier: MIT

config BOARD_AIRPORT_SHUTTLE
	bool "AiportShuttle"
	depends on SOC_NRF52840_QIAA
```

## boards/arm/airport_shuttle/Kconfig.defconfig
```kconfig
# Copyright (c) 2020 Taylor Glaeser
# SPDX-License-Identifier: MIT

if BOARD_AIRPORT_SHUTTLE

config BOARD
	default "airport_shuttle"

config ZMK_KEYBOARD_NAME
	default "Airport Shuttle"
if USB

config USB_NRFX
	default y

config USB_DEVICE_STACK
	default y

endif # USB

config BT_CTLR
	default BT

config ZMK_BLE
	default y

config ZMK_USB
	default y

config I2C
	default y

endif # BOARD_AIRPORT_SHUTTLE
```

## boards/shields/airport_shuttle/Kconfig.shield
```kconfig
config SHIELD_airport_shuttle
    def_bool $(shields_list_contains, airport_shuttle)
```

## config/west.yml
```yaml
manifest:
  remotes:
    - name: zmkfirmware
      url-base: https://github.com/AeternusCo/
  projects:
    - name: zmk-old
      remote: zmkfirmware
      revision: main
      import: app/west.yml
  self:
    path: config
```

## west.yml
```yaml
manifest:
  remotes:
    - name: zmkfirmware
      url-base: https://github.com/AeternusCo/
  projects:
    - name: zmk-old
      remote: zmkfirmware
      revision: airport-shuttle
      import: app/west.yml
  self:
    path: config
```
